## Kconfig
```kconfig
config ZMK_BEHAVIOR_BT_INDICATOR
    bool
    default y
    depends on DT_HAS_ZMK_BEHAVIOR_BT_INDICATOR_ENABLED

if ZMK_BEHAVIOR_BT_INDICATOR

endif #ZMK_BEHAVIOR_BT_INDICATOR
```

## dts/bindings/behaviors/zmk,behavior-bt-glow.yml
```yaml
description: Bluetooth RGB Indicator

compatible: "zmk,behavior-bt-glow"

include: zero_param.yaml
```

## dts/bindings/behaviors/zmk,behavior-bt-indicator.yaml
```yaml
description: Bluetooth RGB Indicator

compatible: "zmk,behavior-bt-indicator"

include: zero_param.yaml
```
