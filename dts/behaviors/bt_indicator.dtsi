/*
 * Copyright (c) 2020 The ZMK Contributors
 *
 * SPDX-License-Identifier: MIT
 */

/ {
    behaviors {
        /omit-if-no-ref/ 
        bt_ind: bt_ind {
            compatible = "zmk,behavior-bt-indicator";
            #binding-cells = <0>;
            display-name = "Bluetooth RGB Indicator";
        };
    };
};
